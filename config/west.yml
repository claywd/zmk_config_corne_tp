## config/west.yml
```yaml
manifest:
  remotes:
    - name: zmkfirmware
      url-base: https://github.com/zmkfirmware
    - name: infused-kim
      url-base: https://github.com/infused-kim
    - name: petejohanson
      url-base: https://github.com/petejohanson
    - name: urob
      url-base: https://github.com/urob
    - name: badjeff
      url-base: https://github.com/badjeff

  projects:

    #
    # zmk fork
    # Uncomment only one of these...
    #

    # Standard ZMK v0.2 with official mouse/pointing support
    # Use with badjeff's driver module (updated for official ZMK)
    - name: zmk
      remote: zmkfirmware
      revision: v0.2
      import: app/west.yml

    # infused-kim's zmk fork with mouse PR, which might be a bit outdated, but
    # is known to be compatible with the PS/2 mouse & TP driver module.
    # NOTE: This fork has known Android BLE mouse compatibility issues
    # - name: zmk
    #   remote: infused-kim
    #   revision: pr-testing/mouse_ps2_module_base
    #   import: app/west.yml

    # pete's zmk fork with the most up to date mouse PR, which is more
    # up-to-date, but may contain incompatibilities with the PS/2 mouse & TP
    # driver module.
    # - name: zmk
    #   remote: petejohanson
    #   revision: feat/pointers-move-scroll
    #   import: app/west.yml

    # urob's zmk fork with mouse PR & many extra features, but may be
    # incompatible with the PS/2 mouse & TP driver module.
    # - name: zmk
    #   remote: urob
    #   revision: main
    #   import: app/west.yml

    # infused-kim's zmk fork with mouse PR AND urob's improvements, which
    # might be out-dated, but is known to be compatible with PS/2 mouse & TP
    # driver module.
    # - name: zmk
    #   remote: infused-kim
    #   revision: pr-testing/mouse_ps2_module_base_urob
    #   import: app/west.yml

    #
    # Additional zmk modules
    #

    # Module for PS/2 mouse & TP driver
    # Using badjeff's fork which is updated for official ZMK v0.2
    - name: kb_zmk_ps2_mouse_trackpoint_driver
      remote: badjeff
      revision: main

  self:
    path: config
```
